## main/Kconfig
```kconfig
menu "Terminal P4"

choice BOARD
    prompt "Target board"
    default BOARD_P4_EV
    help
        Select the ESP32-P4 board variant.

config BOARD_P4_EV
    bool "ESP32-P4 Function EV Board (1024x600 EK79007)"

config BOARD_P4_WAVESHARE
    bool "Waveshare ESP32-P4-WIFI6-Touch-LCD-4B (720x720 ST7703)"

endchoice

config TERM_COLS
    int
    default 83 if BOARD_P4_EV
    default 58 if BOARD_P4_WAVESHARE

config TERM_ROWS
    int
    default 24 if BOARD_P4_EV
    default 29 if BOARD_P4_WAVESHARE

config WIFI_SSID
    string "WiFi SSID"
    default ""

config WIFI_PASS
    string "WiFi Password"
    default ""

config WIFI_TZ
    string "Timezone (POSIX TZ string)"
    default "CST6CDT,M3.2.0,M11.1.0"

endmenu
```

## sdkconfig.defaults
```kconfig
# Target: ESP32-P4
CONFIG_IDF_TARGET="esp32p4"

# Board selection
CONFIG_BOARD_P4_WAVESHARE=y

# Flash
CONFIG_ESPTOOLPY_FLASHSIZE_16MB=y

# CPU
CONFIG_ESP_DEFAULT_CPU_FREQ_360=y
CONFIG_FREERTOS_HZ=1000

# Console
CONFIG_ESP_CONSOLE_USB_SERIAL_JTAG=y

# Main task
CONFIG_ESP_MAIN_TASK_STACK_SIZE=16384

# Partition table
CONFIG_PARTITION_TABLE_CUSTOM=y
CONFIG_PARTITION_TABLE_CUSTOM_FILENAME="partitions.csv"

# PSRAM (required for framebuffer) - 200MHz needs IDF_EXPERIMENTAL_FEATURES
CONFIG_IDF_EXPERIMENTAL_FEATURES=y
CONFIG_SPIRAM=y
CONFIG_SPIRAM_MODE_HEX=y
CONFIG_SPIRAM_SPEED_200M=y

# BLE (NimBLE) via esp_hosted vHCI for keyboard HID host
CONFIG_BT_ENABLED=y
CONFIG_BT_NIMBLE_ENABLED=y
CONFIG_BT_CONTROLLER_DISABLED=y
CONFIG_BT_NIMBLE_TRANSPORT_UART=n
CONFIG_BT_NIMBLE_ROLE_CENTRAL=y
CONFIG_BT_NIMBLE_ROLE_OBSERVER=y
CONFIG_BT_NIMBLE_MAX_CONNECTIONS=1
CONFIG_BT_NIMBLE_HID_SERVICE=y
CONFIG_BT_NIMBLE_NVS_PERSIST=y
CONFIG_BT_NIMBLE_GATT_MAX_PROCS=16
CONFIG_ESP_HOSTED_ENABLE_BT_NIMBLE=y
CONFIG_ESP_HOSTED_NIMBLE_HCI_VHCI=y

# wolfSSH
CONFIG_ESP_ENABLE_WOLFSSH=y

# esp_hosted (ESP32-C6 co-processor on SDIO) for WiFi + BLE
CONFIG_ESP_HOSTED_ENABLED=y
CONFIG_ESP_HOSTED_SDIO_HOST_INTERFACE=y
CONFIG_ESP_HOSTED_IDF_SLAVE_TARGET="esp32c6"
CONFIG_ESP_HOSTED_SDIO_RESET_ACTIVE_HIGH=y
CONFIG_ESP_HOSTED_SDIO_GPIO_RESET_SLAVE=54
CONFIG_ESP_HOSTED_GPIO_SLAVE_RESET_SLAVE=54
CONFIG_ESP_HOSTED_SDIO_4_BIT_BUS=y
CONFIG_ESP_HOSTED_SDIO_BUS_WIDTH=4
CONFIG_ESP_HOSTED_SDIO_CLOCK_FREQ_KHZ=40000
CONFIG_ESP_HOSTED_SDIO_PIN_CMD=19
CONFIG_ESP_HOSTED_SDIO_PIN_CLK=18
CONFIG_ESP_HOSTED_SDIO_PIN_D0=14
CONFIG_ESP_HOSTED_SDIO_PIN_D1=15
CONFIG_ESP_HOSTED_SDIO_PIN_D2=16
CONFIG_ESP_HOSTED_SDIO_PIN_D3=17
CONFIG_ESP_WIFI_REMOTE_ENABLED=y
```
